## base_external/package/ldd-old/Config.in
```kconfig
config BR2_PACKAGE_LDD_OLD
	bool "ldd-old"
	depends on BR2_LINUX_KERNEL
	help
	  Includes the misc-modules & scull in the kernel image.
```

## base_external/package/ldd/Config.in
```kconfig
config BR2_PACKAGE_LDD
	bool "ldd"
	depends on BR2_LINUX_KERNEL
	help
	  Includes the misc-modules & scull in the kernel image.
```
